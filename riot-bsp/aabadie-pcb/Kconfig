## riot-bsp/aabadie-pcb/Kconfig
```kconfig
# Copyright (c) 2023 Inria
#
# This file is subject to the terms and conditions of the GNU Lesser
# General Public License v2.1. See the file LICENSE in the top level
# directory for more details.

config BOARD
    default "aabadie-pcb" if BOARD_AABADIE_PCB

config BOARD_AABADIE_PCB
    bool
    default y
    select CPU_MODEL_STM32L476RG

    # Put defined MCU peripherals here (in alphabetical order)
    select HAS_PERIPH_I2C
    select HAS_PERIPH_TIMER
    select HAS_PERIPH_UART
    select HAS_PERIPH_USBDEV

    # Put other features for this board (in alphabetical order)
    select HAS_PERIPH_HIGHLEVEL_STDIO

    # Clock configuration
    select BOARD_HAS_HSE

    select HAVE_BME860

source "$(RIOTBOARD)/common/stm32/Kconfig"
```
